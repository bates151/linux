## security/hifi/Kconfig
```kconfig
#
# Kernel configuration file for the Hi-Fi provenance system
#
# Copyright (C) 2013 The Pennsylvania State University
# Systems and Internet Infrastructure Security Laboratory
#
# Author: Devin J. Pohly <djpohly@cse.psu.edu>
#
# This program is free software; you can redistribute it and/or modify
# it under the terms of the GNU General Public License as published by
# the Free Software Foundation, version 2 of the License.
#

config SECURITY_HIFI
	bool "High-fidelity provenance monitor"
	depends on SECURITY
	default n
	help
	  This enables the high-fidelity provenance monitor (Hi-Fi).

	  If you are unsure how to answer this question, answer N.
```

## security/pmsm/Kconfig
```kconfig
config SECURITY_PMSM
	bool "Provenance monitor security module"
	depends on SECURITY
	default n
	help
	  This enables the provenance monitor security module (PM/SM).

	  If you are unsure how to answer this question, answer N.
```
